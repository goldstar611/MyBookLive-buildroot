## configs/mybooklive_defconfig
```kconfig
BR2_powerpc=y
BR2_powerpc_464fp=y
BR2_OPTIMIZE_FAST=y
BR2_SSP_STRONG=y
BR2_RELRO_PARTIAL=y
BR2_FORTIFY_SOURCE_1=y
BR2_TOOLCHAIN_BUILDROOT_GLIBC=y
BR2_KERNEL_HEADERS_4_14=y
BR2_GCC_VERSION_8_X=y
BR2_TOOLCHAIN_BUILDROOT_CXX=y
BR2_TARGET_GENERIC_PASSWD_SHA512=y
BR2_INIT_NONE=y
BR2_ROOTFS_DEVICE_CREATION_STATIC=y
# BR2_TARGET_ENABLE_ROOT_LOGIN is not set
BR2_SYSTEM_BIN_SH_NONE=y
# BR2_TARGET_GENERIC_GETTY is not set
# BR2_TARGET_GENERIC_REMOUNT_ROOTFS_RW is not set
BR2_ROOTFS_POST_BUILD_SCRIPT="board/mybooklive/post-build.sh"
BR2_LINUX_KERNEL=y
BR2_LINUX_KERNEL_CUSTOM_VERSION=y
BR2_LINUX_KERNEL_CUSTOM_VERSION_VALUE="4.14.111"
BR2_LINUX_KERNEL_PATCH="board/mybooklive/patches/linux"
BR2_LINUX_KERNEL_USE_CUSTOM_CONFIG=y
BR2_LINUX_KERNEL_CUSTOM_CONFIG_FILE="board/mybooklive/config_mbl"
BR2_LINUX_KERNEL_DTS_SUPPORT=y
BR2_LINUX_KERNEL_CUSTOM_DTS_PATH="board/mybooklive/dts/apm82181.dtsi board/mybooklive/dts/apollo3g.dts"
BR2_LINUX_KERNEL_INSTALL_TARGET=y
# BR2_PACKAGE_BUSYBOX is not set
```
